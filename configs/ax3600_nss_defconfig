## configs/ax3600_nss_defconfig
```kconfig
CONFIG_TARGET_qualcommax=y
CONFIG_TARGET_qualcommax_ipq807x=y
CONFIG_TARGET_qualcommax_ipq807x_DEVICE_xiaomi_ax3600=y
CONFIG_TARGET_ROOTFS_SQUASHFS=y
CONFIG_TARGET_ROOTFS_INITRAMFS=n
CONFIG_TARGET_KERNEL_PARTSIZE=64
CONFIG_TARGET_ROOTFS_PARTSIZE=1024
CONFIG_TARGET_PER_DEVICE_ROOTFS=y
CONFIG_TARGET_SQUASHFS_BLOCK_SIZE=256
CONFIG_TARGET_IMAGES_GZIP=y

# 二次编译提速：OpenWrt 会自带 host ccache，配合 GHA 的 ~/.ccache 缓存生效
CONFIG_CCACHE=y

# ---- LuCI + 中文 ----
CONFIG_PACKAGE_luci=y
CONFIG_PACKAGE_luci-base=y
CONFIG_PACKAGE_luci-compat=y
CONFIG_PACKAGE_luci-ssl-openssl=y
CONFIG_PACKAGE_luci-i18n-base-zh-cn=y
CONFIG_LUCI_LANG_zh_Hans=y
CONFIG_PACKAGE_luci-app-opkg=y
CONFIG_PACKAGE_luci-app-firewall=y
CONFIG_PACKAGE_luci-app-package-manager=y

# =====================================================================
# OpenClash 运行时依赖（编进固件）
# 这些 kmod 必须与内核同版本编译，事后装容易版本不匹配 —— 所以内置。
# OpenClash 本体（luci-app-openclash + 内核二进制）更新频繁，刷完再装。
# 包名如不存在，make defconfig 会静默忽略，不影响编译。
# =====================================================================
CONFIG_PACKAGE_kmod-tun=y
CONFIG_PACKAGE_kmod-nft-tproxy=y
CONFIG_PACKAGE_kmod-inet-diag=y
CONFIG_PACKAGE_kmod-nf-conntrack-netlink=y
CONFIG_PACKAGE_kmod-nft-core=y
CONFIG_PACKAGE_kmod-nft-nat=y
CONFIG_PACKAGE_kmod-ipt-nat=y
CONFIG_PACKAGE_kmod-nf-ipt=y
CONFIG_PACKAGE_kmod-nf-nat=y

# ---- 代理/网络工具 ----
CONFIG_PACKAGE_dnsmasq-full=y
CONFIG_PACKAGE_ipset=y
CONFIG_PACKAGE_iptables=y
CONFIG_PACKAGE_iptables-mod-extra=y
CONFIG_PACKAGE_nftables=y
CONFIG_PACKAGE_kmod-nft-offload=y
CONFIG_PACKAGE_curl=y
CONFIG_PACKAGE_ca-bundle=y
CONFIG_PACKAGE_ca-certificates=y
CONFIG_PACKAGE_wget-ssl=y
CONFIG_PACKAGE_unzip=y
CONFIG_PACKAGE_tar=y
CONFIG_PACKAGE_coreutils-nohup=y
CONFIG_PACKAGE_bash=y
CONFIG_PACKAGE_ip-full=y
CONFIG_PACKAGE_tcpdump-mini=y

# ---- 运维 ----
CONFIG_PACKAGE_htop=y
CONFIG_PACKAGE_nano=y
CONFIG_PACKAGE_openssh-sftp-server=y
CONFIG_PACKAGE_block-mount=y

# ---- 内存紧张，打开 zram（AX3600 只有 413MB 可用）----
CONFIG_PACKAGE_zram-swap=y

# AX3600 无 USB，关闭相关包省体积
CONFIG_PACKAGE_kmod-usb3=n
CONFIG_PACKAGE_kmod-usb-dwc3=n
CONFIG_PACKAGE_kmod-usb-dwc3-qcom=n
```
